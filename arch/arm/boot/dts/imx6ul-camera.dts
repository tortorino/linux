/dts-v1/;

/* i.MX6UL CPU */
#include "imx6ul.dtsi"
/* ConnectCore 6UL module */
#include "imx6ul-ccimx6ul-wb.dtsi"

/ {
        model = "Archer ConnectCore 6UL based platform";
        compatible = "mycc6ulboard", "digi,ccimx6ul", "fsl,imx6ul";
        digi,machine,name = "custom";
};
